# file: Practica_Dos.ioc
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Mcu.Family=STM32F4
Mcu.Name=STM32F401R(B-C)Tx
Mcu.Package=LQFP64
NVIC.PriorityGroup=NVIC_PRIORITYGROUP_4
PC13-ANTI_TAMP.GPIO_PuPd=GPIO_NOPULL
PC13-ANTI_TAMP.Signal=GPIO_Output
ProjectManager.HeapSize=0x200
ProjectManager.StackSize=0x400
ProjectManager.TargetToolchain=STM32CubeIDE
RCC.AHBFreq_Value=16000000
RCC.APB1Freq_Value=16000000
RCC.APB2Freq_Value=16000000
RCC.CortexFreq_Value=16000000
RCC.HSE_VALUE=25000000
RCC.HSI_VALUE=16000000
RCC.LSE_VALUE=32768
RCC.SYSCLKFreq_VALUE=16000000
RCC.VCOOutputFreq_Value=192000000
board=custom

// file: Core/Src/main.c
#include "main.h"
#include "gpio.h"

/* USER CODE BEGIN PD */
#define cicTr 2 //cte. para dividir el ciclo de trabajo
#define noSec 3 //número de secuencias
#define noCicTr 5 //número de veces a parpadear
#define valInCont 0 //cte. para inicializar contador
/* USER CODE END PD */

void SystemClock_Config(void);

int main(void)
{

  /* MCU Configuration--------------------------------------------------------*/

  /* Reset of all peripherals, Initializes the Flash interface and the Systick. */
  HAL_Init();

  SystemClock_Config();
  MX_GPIO_Init();

/* USER CODE BEGIN 2 */
    delay_t  delay; //crea tipo de dato delay_t llamado delay
    delay_t * punt_Delay = NULL; //puntero tipo delay_t inicializado
    punt_Delay = &delay; //puntero almacena la direccion de la variable delay
  	tick_t duration = 1000; //se designa una duracion de 1000 ms
  	bool_t retDelRead; // variable tipo bool_t para guardar el retorno de delayRead
  	delayInit(punt_Delay,duration); //asignacion de datos para la funcion delayInit
  	//contador para la secuencia del led
  	uint8_t contador = valInCont;
  	//vector que define las diferencies duraciones del periodo para secuencia
  	uint32_t v_Duracion [noSec]={1000,200,100};
/* USER CODE END 2 */

  /* Infinite loop */
  /* USER CODE BEGIN WHILE */
  while (1)
  {
	  //Casos para el Punto 3 de la practica
	  if(contador<noCicTr*cicTr){delayWrite(punt_Delay,v_Duracion[0]/cicTr);}
	  if(contador>=noCicTr*cicTr && contador< 2*noCicTr*cicTr){delayWrite(punt_Delay, v_Duracion[1]/cicTr);}
	  if(contador>=2*noCicTr*cicTr && contador< 3*noCicTr*cicTr){delayWrite(punt_Delay,v_Duracion[2]/cicTr);}
	  if(contador>=3*noCicTr*cicTr){contador=valInCont;}

	  //Leer valor arrojado de la función delayRead y asignar a variable
	  retDelRead = delayRead(punt_Delay);
    /* USER CODE END WHILE */

	  //Si se alcanza la duracion, se niega el estado del led con Toggle
	  if(retDelRead)
	  {
	  //GPIOC 13 es la salida del Led de la placa F401RCT6
	  HAL_GPIO_TogglePin(GPIOC,GPIO_PIN_13);

	  //Contador para casos del Punto 3 de la práctica
	  contador++;
	  }

  }
}

//Funcion de delayInit sin retorno
void delayInit( delay_t * delay, tick_t duration )
{
	delay->duration= duration; //asigna en delay.duracion la duracion definida en la funcion
	delay->running = false; // asigna en delay.running "falso"
}

//Funcion de delayRead con retorno de dato tipo bool_t (bool)
bool_t delayRead( delay_t * delay )
{

	//verifica el estado de delay.running
	//si delay.running es falso, empieza conteo y cambia su estado a verdadero
	if(delay->running == false)
	{
		delay->startTime = HAL_GetTick();
		delay->running = true;

	}
	//si delay.running es verdadero, revisa si se ha alcanzado el periodo designado
	//si se alcanzó, retorna "verdadero", y delay.running cambia a "falso";
	//en caso contrario, retorna "falso"
	else
	{
		if((HAL_GetTick()-delay->startTime) >= delay->duration)
		{
			delay->running = false;
			return true;
		}

	}

	return false;
}

//Funcion de delayWrite sin retorno
void delayWrite( delay_t * delay, tick_t duration)
{
	//Asigna un valor de duracion existente a delay.duration
	delay->duration= duration;
}

void SystemClock_Config(void)
{
  RCC_OscInitTypeDef RCC_OscInitStruct = {0};
  RCC_ClkInitTypeDef RCC_ClkInitStruct = {0};

  /** Configure the main internal regulator output voltage
  */
  __HAL_RCC_PWR_CLK_ENABLE();
  __HAL_PWR_VOLTAGESCALING_CONFIG(PWR_REGULATOR_VOLTAGE_SCALE2);

  /** Initializes the RCC Oscillators according to the specified parameters
  * in the RCC_OscInitTypeDef structure.
  */
  RCC_OscInitStruct.OscillatorType = RCC_OSCILLATORTYPE_HSI;
  RCC_OscInitStruct.HSIState = RCC_HSI_ON;
  RCC_OscInitStruct.HSICalibrationValue = RCC_HSICALIBRATION_DEFAULT;
  RCC_OscInitStruct.PLL.PLLState = RCC_PLL_NONE;
  if (HAL_RCC_OscConfig(&RCC_OscInitStruct) != HAL_OK)
  {
    Error_Handler();
  }

  /** Initializes the CPU, AHB and APB buses clocks
  */
  RCC_ClkInitStruct.ClockType = RCC_CLOCKTYPE_HCLK|RCC_CLOCKTYPE_SYSCLK
                              |RCC_CLOCKTYPE_PCLK1|RCC_CLOCKTYPE_PCLK2;
  RCC_ClkInitStruct.SYSCLKSource = RCC_SYSCLKSOURCE_HSI;
  RCC_ClkInitStruct.AHBCLKDivider = RCC_SYSCLK_DIV1;
  RCC_ClkInitStruct.APB1CLKDivider = RCC_HCLK_DIV1;
  RCC_ClkInitStruct.APB2CLKDivider = RCC_HCLK_DIV1;

  if (HAL_RCC_ClockConfig(&RCC_ClkInitStruct, FLASH_LATENCY_0) != HAL_OK)
  {
    Error_Handler();
  }
}

void Error_Handler(void)
{
  __disable_irq();
  while (1)
  {
  }
}
